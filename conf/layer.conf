## conf/layer.conf
```bitbake
# We have a conf and classes directory, add to BBPATH
BBPATH .= ":${LAYERDIR}"

# We have a packages directory, add to BBFILES
BBFILES += "${LAYERDIR}/recipes-*/*/*.bb \
            ${LAYERDIR}/recipes-*/*/*.bbappend"

BBFILE_COLLECTIONS += "meta-egamer"
BBFILE_PATTERN_meta-egamer := "^${LAYERDIR}/"
BBFILE_PRIORITY_meta-egamer = "5"
LAYERSERIES_COMPAT_meta-egamer = "scarthgap"

# Add the licenses into the metadata
LICENSE_PATH += "${LAYERDIR}/custom-licenses"

PREFERRED_PROVIDER_linux/kernel = "linux-yocto"

DEFAULTTUNE:virtclass-multilib-lib32 = "x86"
ABI_LIB32 = "lib32"

DISTRO_FEATURES:append = " multilib"
IMAGE_INSTALL:append = " lib32-glibc libstdc++"
```
